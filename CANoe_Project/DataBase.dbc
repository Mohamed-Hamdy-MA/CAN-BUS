VERSION ""

NS_ :

BS_:

BU_: Speed_Sensor Accelerator

BO_ 939 Speed_Message: 1 Speed_Sensor
 SG_ Speed_Value : 0|8@1+ (1,0) [0|255] "km/h"  Accelerator

BO_ 48 Acceleration_Message: 1 Accelerator
 SG_ Acceleration_Command : 0|1@1+ (1,0) [0|1] ""  Speed_Sensor
